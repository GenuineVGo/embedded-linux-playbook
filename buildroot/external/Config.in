## buildroot/external/Config.in
```kconfig
source "$BR2_EXTERNAL_VINCENT_PATH/package/vincent-hello/Config.in"
source "$BR2_EXTERNAL_VINCENT_PATH/package/vincent-sensors/Config.in"
```

## buildroot/external/package/vincent-hello/Config.in
```kconfig
config BR2_PACKAGE_VINCENT_HELLO
	bool "vincent-hello"
	help
	  Hello world kernel module — Phase 1 learning exercise.
```

## buildroot/external/package/vincent-sensors/Config.in
```kconfig
config BR2_PACKAGE_VINCENT_SENSORS
	bool "vincent-sensors"
	help
	  Custom I2C/SPI sensor drivers — Phase 3 learning exercise.
```

## yocto/meta-vincent/conf/layer.conf
```bitbake
BBPATH .= ":${LAYERDIR}"
BBFILES += "${LAYERDIR}/recipes-*/*/*.bb \
            ${LAYERDIR}/recipes-*/*/*.bbappend"

BBFILE_COLLECTIONS += "vincent"
BBFILE_PATTERN_vincent = "^${LAYERDIR}/"
BBFILE_PRIORITY_vincent = "10"

LAYERDEPENDS_vincent = "core"
LAYERSERIES_COMPAT_vincent = "scarthgap"
```
